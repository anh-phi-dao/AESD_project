## main/Kconfig.projbuild
```kconfig
# Add configuration entries here only when a component consumes them.
# Solenoid, auto-lock timeout, and audio settings are deferred until their implementations exist.

menu "PCF8574 driver configuration"

config PCF8574_DEFAULT_SDA_PIN
    int "Default SDA GPIO"
    default 15
    help
        GPIO used as the default I2C SDA line when the configuration leaves it unspecified.

config PCF8574_DEFAULT_SCL_PIN
    int "Default SCL GPIO"
    default 7
    help
        GPIO used as the default I2C SCL line when the configuration leaves it unspecified.

config PCF8574_DEFAULT_INT_PIN
    int "Default interrupt GPIO"
    default 6
    help
        GPIO used as the default PCF8574 interrupt input.

config PCF8574_DEFAULT_I2C_ADDR
    hex "Default I2C address"
    default 0x20
    help
        Seven-bit I2C address used by the default PCF8574 configuration.

config PCF8574_DEFAULT_CLK_SPEED_HZ
    int "Default I2C clock speed (Hz)"
    default 100000
    help
        I2C clock speed used by the default PCF8574 configuration.

endmenu

menu "Door simulator (dev board)"

config DOOR_SIM_ENABLE
    bool "Simulate lock activity without keypad, NFC or sensors"
    default n
    help
        Creates access events and alerts from the BOOT button and the "sim" serial console command, through the
        same event log the real lock logic will use, so MQTT and the web page can be tested on a bare ESP32-S3.
        Nothing from the network can trigger it. Off by default: enable only on a dev board, and do not commit
        sdkconfig with it enabled.

config DOOR_SIM_BUTTON_GPIO
    int "Simulator button GPIO (active low)"
    depends on DOOR_SIM_ENABLE
    default 0
    help
        GPIO0 is the BOOT button of ESP32-S3 dev boards. Short press: access attempt. Hold 1 s: tamper alert.

endmenu

menu "TFT display (ILI9341) and UI"

config UI_ENABLE
    bool "Drive the ILI9341 TFT with LVGL"
    default y
    help
        Starts the display driver, LVGL and the screen UI (app/ui_service). Without a SquareLine export the UI is a
        built-in test screen. The lock works the same without a screen.

config UI_LCD_SPI_HOST
    int "SPI host (1 = SPI2, 2 = SPI3)"
    depends on UI_ENABLE
    range 1 2
    default 1

config UI_LCD_MOSI_GPIO
    int "MOSI GPIO"
    depends on UI_ENABLE
    default 11

config UI_LCD_SCLK_GPIO
    int "SCLK GPIO"
    depends on UI_ENABLE
    default 12

config UI_LCD_CS_GPIO
    int "CS GPIO"
    depends on UI_ENABLE
    default 10

config UI_LCD_DC_GPIO
    int "DC GPIO"
    depends on UI_ENABLE
    default 13

config UI_LCD_RST_GPIO
    int "RESET GPIO"
    depends on UI_ENABLE
    default 14

config UI_LCD_BL_GPIO
    int "Backlight GPIO (-1: not wired, always on)"
    depends on UI_ENABLE
    default -1

config UI_LCD_BL_ACTIVE_HIGH
    bool "Backlight is on when the GPIO is high"
    depends on UI_ENABLE && UI_LCD_BL_GPIO >= 0
    default y

config UI_LCD_PCLK_HZ
    int "SPI clock (Hz)"
    depends on UI_ENABLE
    range 1000000 80000000
    default 26000000
    help
        26 MHz is verified with jumper wires on the dev board (test/test_ili9341_implement). Lower it if the picture
        shows noise.

config UI_LVGL_BUF_LINES
    int "LVGL draw buffer height (lines)"
    depends on UI_ENABLE
    range 10 40
    default 20
    help
        Two buffers of (320 x lines x 2 bytes) are taken from internal RAM. The ILI9341 driver converts at most
        12800 pixels per flush, so 40 lines is the limit.

endmenu
```
